## conf/machine/nanopi-m1-senic.conf
```bitbake
#@TYPE: Machine
#@NAME: nanopi-m1-senic
#@DESCRIPTION: Machine configuration for the FriendlyARM NanoPi M1, based on the Allwinner H3 CPU. Specific to senic platform because wifi and bluetooth are added using USB dongles

require conf/machine/nanopi-m1.conf

# U-Boot configurations
PREFERRED_PROVIDER_virtual/bootloader = "u-boot-fe"
PREFERRED_VERSION_u-boot = "v2017.03+git%"
UBOOT_MACHINE = "nanopi_m1_defconfig"

# To create a wic image to deploy it on a SD-card
IMAGE_FSTYPES += "wic"
WKS_FILES = "senic-sdcard.wks"
# Dependencies needed for wic
EXTRA_IMAGEDEPENDS += "dosfstools-native mtools-native"
```

## conf/machine/nanopi-m1.conf
```bitbake
#@TYPE: Machine
#@NAME: nanopi-m1
#@DESCRIPTION: Machine configuration for the FriendlyARM NanoPi M1, based on the Allwinner H3 CPU

include conf/machine/include/soc-family.inc
require conf/machine/include/tune-cortexa7.inc

SOC_FAMILY = "sun8i"
DEFAULTTUNE = "cortexa7hf-neon-vfpv4"

PREFERRED_PROVIDER_virtual/kernel ?= "linux"
PREFERRED_PROVIDER_virtual/bootloader ?= "u-boot"

PREFERRED_VERSION_linux = "4.10"
PREFERRED_VERSION_u-boot = "v2016.03+git%"

KERNEL_IMAGETYPE = "zImage"
KERNEL_DEVICETREE = "sun8i-h3-nanopi-m1.dtb"

UBOOT_ARCH = "arm"
UBOOT_MACHINE = "orangepi_pc_defconfig"

SERIAL_CONSOLE = "115200 ttyS0"

IMAGE_FSTYPES += "ext4"

# To build the u-boot image
EXTRA_IMAGEDEPENDS += "virtual/bootloader"
```

## meta-senic/conf/distro/senic.conf
```bitbake
DISTRO_NAME = "senic"
DISTRO_VERSION  = "1.0"

IMAGE_LINGUAS = "en-gb"

DISTRO_FEATURES = "${DISTRO_FEATURES_DEFAULT} ${DISTRO_FEATURES_LIBC} sysvinit usb bluetooth wifi"
DISTRO_TYPE ?= "release"
```

## meta-senic/conf/machine/nanopi-neo.conf
```bitbake
#@TYPE: Machine
#@NAME: nanopi-neo
#@DESCRIPTION: Machine configuration for the FriendlyARM NanoPi NEO, based on the Allwinner H3 CPU

include conf/machine/include/soc-family.inc
require conf/machine/include/tune-cortexa7.inc

SOC_FAMILY = "sun8i"
DEFAULTTUNE = "cortexa7hf-neon-vfpv4"

PREFERRED_PROVIDER_virtual/kernel ?= "linux"
PREFERRED_PROVIDER_virtual/bootloader ?= "u-boot"

PREFERRED_VERSION_linux = "4.10"
PREFERRED_VERSION_u-boot = "v2016.03+git%"

KERNEL_IMAGETYPE = "zImage"
KERNEL_DEVICETREE = "sun8i-h3-senic-hub.dtb"

UBOOT_ARCH = "arm"
UBOOT_MACHINE = "nanopi_neo_defconfig"

SERIAL_CONSOLE = "115200 ttyS0"

IMAGE_FSTYPES += "ext4"

# To build the u-boot image
EXTRA_IMAGEDEPENDS += "virtual/bootloader"
```

## meta-senic/conf/machine/senic-hub-beta.conf
```bitbake
#@TYPE: Machine
#@NAME: senic-hub-beta
#@DESCRIPTION: Machine configuration for Senic Hub Beta that is based on NanoPi M1

require conf/machine/senic-hub.conf

# Kernel
KERNEL_DEVICETREE = "sun8i-h3-nanopi-m1.dtb"

# Bootloader
UBOOT_MACHINE = "nanopi_m1_defconfig"
```

## meta-senic/conf/machine/senic-hub.conf
```bitbake
#@TYPE: Machine
#@NAME: senic-hub
#@DESCRIPTION: Machine configuration for Senic Hub Beta that is based on NanoPi NEO from FriendlyARM with Allwinner H3 CPU, 512 MB RAM

require conf/machine/nanopi-neo.conf

# U-Boot configurations
PREFERRED_PROVIDER_virtual/bootloader = "u-boot-fe"
PREFERRED_VERSION_u-boot = "v2017.03+git%"
UBOOT_MACHINE = "nanopi_neo_defconfig"

# Add Bluetooth as machine features as USB dongles will be used
MACHINE_FEATURES += "bluetooth wifi"

# To create a wic image to deploy it on a SD-card
IMAGE_FSTYPES += "wic"
WKS_FILES = "senic-sdcard.wks"
# Dependencies needed for wic
EXTRA_IMAGEDEPENDS += "dosfstools-native mtools-native"
MACHINE_EXTRA_RDEPENDS += "kernel-modules"
```
